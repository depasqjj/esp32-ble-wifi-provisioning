## sdkconfig.defaults.txt
```kconfig
CONFIG_WIFI_PROV_SCAN_MAX_ENTRIES=10
CONFIG_WIFI_PROV_STA_ALL_CHANNEL_SCAN=y
CONFIG_WIFI_PROV_AUTOSTOP_TIMEOUT=30
CONFIG_LOG_DEFAULT_LEVEL_INFO=y
CONFIG_LOG_COLORS=y
CONFIG_PARTITION_TABLE_CUSTOM=y
CONFIG_PARTITION_TABLE_CUSTOM_FILENAME="partitions.csv"
CONFIG_PARTITION_TABLE_OFFSET=0x8000
```
